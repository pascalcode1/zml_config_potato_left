## config/boards/shields/potato_left/Kconfig.defconfig
```kconfig
if SHIELD_POTATO_LEFT_ONLY

    config ZMK_KEYBOARD_NAME
        default "potato_left_only"

    config BT
        default y

endif
```

## config/boards/shields/potato_left/Kconfig.shield
```kconfig
config SHIELD_POTATO_LEFT_ONLY
    def_bool $(shields_list_contains, potato_left_only)
```
